/dts-v1/;
/plugin/;

/ {
    compatible = "brcm,bcm2837";

    fragment@0 {
        target-path = "/";
        __overlay__ {
            wifi_pwrseq: wifi-pwrseq {
                compatible = "mmc-pwrseq-simple";
                reset-gpios = <&gpio 41 1>;
                post-power-on-delay-ms = <10>;
                power-off-delay-us = <10000>;
            };
        };
    };

    fragment@1 {
        target = <&mmcnr>;
        __overlay__ {
            mmc-pwrseq = <&wifi_pwrseq>;
        };
    };
};
